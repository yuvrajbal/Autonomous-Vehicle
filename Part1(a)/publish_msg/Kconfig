## Part1(a)/publish_msg/Kconfig
```kconfig
menuconfig EXAMPLES_PUBLISH_MSG
	bool "publish_msg"
	default n
	---help---
		Enable support for publish_msg
```

## rc_receive/Kconfig
```kconfig
menuconfig EXAMPLES_RC_RECEIVE
	bool "rc_receive"
	default n
	---help---
		Enable support for rc_receive
```
